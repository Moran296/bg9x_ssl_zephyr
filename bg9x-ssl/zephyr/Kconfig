## bg9x-ssl/zephyr/Kconfig
```kconfig
config BG9X_MODEM_SSL
	bool "Support for bg9x modem with offloaded ssl sockets"
  select MODEM
	select MODEM_MODULES
	select MODEM_CHAT
	select MODEM_PIPE
	select MODEM_BACKEND_UART
  select PM_DEVICE
	select NET_SOCKETS_OFFLOAD
  select DNS_RESOLVER
	depends on DT_HAS_QUECTEL_BG95_ENABLED
	help
	  This driver implements a modem driver for the BG9X
	  with the SSL sockets offloaded to the modem.

if BG9X_MODEM_SSL

config BG9X_MODEM_SSL_APN
	string "APN"
	default "internet"

config BG9X_MODEM_SSL_SECURITY_LEVEL
    int "SSL security level"
    default 2
    help
      The security level to use for the SSL connection.
      refer to BG95 SSL application seclevel command for details.
      0: No authentication
      1: Manage server authentication
      2: Manage server and client authentication if requested by the remote server

if BG9X_MODEM_SSL_SECURITY_LEVEL > 0

config BG9X_MODEM_SSL_CA_CERT
    string "CA certificate"
    help
      The CA certificate to use for the SSL connection.
      refer to BG95 SSL application AT+QSSLCFG="cacert" command for details.

endif

if BG9X_MODEM_SSL_SECURITY_LEVEL > 1

config BG9X_MODEM_SSL_CLIENT_CERT
    string "client public key certificate"
    help
      The client public key certificate to use for the SSL connection.
      refer to BG95 SSL application AT+QSSLCFG="clientcert" command for details.

config BG9X_MODEM_SSL_CLIENT_KEY
    string "client private key certificate"
    help
      The client private key to use for the SSL connection.
      refer to BG95 SSL application AT+QSSLCFG="clientkey" command for details.

endif

endif # BG9X_MODEM_SSL
```
